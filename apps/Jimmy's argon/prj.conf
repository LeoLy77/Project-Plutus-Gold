## CMakeLists.txt
```
# SPDX-License-Identifier: Apache-2.0

cmake_minimum_required(VERSION 3.13.1)
find_package(Zephyr REQUIRED HINTS $ENV{ZEPHYR_BASE})
project(Project)

include_directories(inc)

target_sources(app PRIVATE src/main.c src)
```

## prj.conf
```kconfig
CONFIG_GPIO=y
CONFIG_STDOUT_CONSOLE=y

CONFIG_USB=y
CONFIG_USB_DEVICE_STACK=y
CONFIG_USB_DEVICE_PRODUCT="Particle Argon"
CONFIG_USB_DRIVER_LOG_LEVEL_ERR=y
CONFIG_USB_CDC_ACM=y
CONFIG_USB_DEVICE_LOG_LEVEL_ERR=y
CONFIG_SERIAL=y
CONFIG_UART_INTERRUPT_DRIVEN=y
CONFIG_UART_LINE_CTRL=y

CONFIG_PRINTK=y
CONFIG_LOG_PRINTK=y

CONFIG_SHELL=y
CONFIG_LOG=y
CONFIG_INIT_STACKS=y
CONFIG_THREAD_STACK_INFO=y
CONFIG_KERNEL_SHELL=y
CONFIG_THREAD_MONITOR=y
CONFIG_BOOT_BANNER=n
CONFIG_THREAD_NAME=y
CONFIG_DEVICE_SHELL=y
CONFIG_POSIX_CLOCK=y
CONFIG_DATE_SHELL=y
CONFIG_THREAD_RUNTIME_STATS=y
CONFIG_UART_SHELL_ON_DEV_NAME="CDC_ACM_0"


CONFIG_HEAP_MEM_POOL_SIZE=256
CONFIG_USB_UART_CONSOLE=y
CONFIG_SHELL_BACKEND_SERIAL_INIT_PRIORITY=51
CONFIG_SHELL_PROMPT_UART="Argon:~$ "
CONFIG_CBPRINTF_FP_SUPPORT=y


CONFIG_SPI=y

CONFIG_BT=y
CONFIG_BT_DEBUG_LOG=y
CONFIG_BT_SMP=y
CONFIG_BT_PERIPHERAL=y
CONFIG_BT_DIS=y
CONFIG_BT_DIS_PNP=n
CONFIG_BT_BAS=y
CONFIG_BT_DEVICE_NAME="BEACON2"
CONFIG_BT_DEVICE_APPEARANCE=768
CONFIG_BT_ATT_ENFORCE_FLOW=n
CONFIG_CBPRINTF_FP_SUPPORT=y
```

## src/main.c
```c
#include <stdio.h>
#include <stdlib.h>
#include <string.h>

#include <zephyr.h>
#include <devicetree.h>
#include <device.h>
#include <logging/log.h>
#include <version.h>

#include <zephyr/types.h>
#include <sys/printk.h>
#include <sys/util.h>

#include <drivers/gpio.h>
#include <drivers/spi.h>
#include <usb/usb_device.h>
#include <drivers/uart.h>

#define STACKSIZE 2048
#define TASK_PRIORITY 14

/* The devicetree node identifier for the "led0" alias. */
#define LED0_NODE DT_ALIAS(led0)
#define LED0	DT_GPIO_LABEL(LED0_NODE, gpios)
#define PIN	DT_GPIO_PIN(LED0_NODE, gpios)
#define FLAGS	DT_GPIO_FLAGS(LED0_NODE, gpios)

const struct device *spi_dev;
static const struct spi_config spi_cfg_master = {
    .operation = SPI_OP_MODE_MASTER | SPI_WORD_SET(8) | SPI_TRANSFER_MSB | SPI_MODE_CPHA,
	.frequency = 10000000U,
};

void main(void) 
{
	/* USB CDC Enable */
	const struct device *dev;
	int ret;
	dev = device_get_binding("CDC_ACM_0");
    if (!dev) {
        return;
    }

    ret = usb_enable(NULL);
    if (ret != 0) {
        return;
    }
	printk("USB ACM enabled\n");
	return;
}


/* Function Definitions */
uint8_t spi_receive(uint8_t* data_buf, uint32_t data_len) 
{
	uint8_t err;
	/* Create spi structs */
    struct spi_buf buf = { .buf = data_buf, .len = data_len };
    struct spi_buf_set buf_set = { .buffers = &buf, .count = 1 };

	/* Receive via spi */
	err = spi_read(spi_dev, &spi_cfg_master, &buf_set);
	// err = spi_transceive(spi_dev, &spi_cfg_slave, NULL, &buf_set);

	return err;
}

void spi_transmit(uint8_t *data_buf, uint8_t data_len) {
    uint8_t err = 1;

    /* Create spi structs */
    struct spi_buf buf = { .buf = data_buf, .len = data_len };
    struct spi_buf_set buf_set = { .buffers = &buf, .count = 1 };

	err = spi_write(spi_dev, &spi_cfg_master, &buf_set);
    return;
}

/* Tasks */
void LED_Blink_Task(void) 
{
	const struct device *gpio_dev = device_get_binding(LED0);
    gpio_pin_configure(gpio_dev, PIN, GPIO_OUTPUT_ACTIVE | FLAGS);
	bool is_on = true;

	while(1)
	{
		gpio_pin_set(gpio_dev, PIN, (int)is_on);
		is_on = !is_on;
		k_msleep(1000);
	}
}

typedef struct Point_t
{
	float x;
	float y;
} Point;

void SPI_Receive_Task(void) 
{
	uint8_t rx_buf[8];
	uint8_t** rx_buffer;
	uint8_t num_points;
	Point points[64];
	uint32_t test;

	spi_dev = device_get_binding("SPI_3");
	if (spi_dev == NULL) {
		printk("SPI could not be initialised");
    } else {
		printk("SPI has successfully initialised");
    }

	while(1) {
		do {
			memset(rx_buf, 0, sizeof(rx_buf));
			spi_receive(rx_buf, 8);
			k_msleep(200);
		} while (rx_buf[0] != 0xA0);

		num_points = rx_buf[1];
		printk("Number of Detected Objects: %d\r\n", num_points);

		for (uint8_t i = 0; i < num_points; i++)
		{
			memset(rx_buf, 0, sizeof(rx_buf));
			spi_receive(rx_buf, 8);

			test = rx_buf[0] << 24 | rx_buf[1] << 16 | rx_buf[2] << 8 | rx_buf[3];
			points[i].x = *((float*)&test);
			test = rx_buf[4] << 24 | rx_buf[5] << 16 | rx_buf[6] << 8 | rx_buf[7];
			points[i].y = *((float*)&test);
		}	

		for (uint8_t i = 0; i < num_points; i++)
		{
			printk("(%.6f, %.6f)\n", points[i].x, points[i].y);
		}

		memset(points, 0, sizeof(Point) * num_points);

	}
}

K_THREAD_DEFINE(LED_Blink, STACKSIZE, LED_Blink_Task, NULL,NULL,NULL, TASK_PRIORITY, 0, 0);
K_THREAD_DEFINE(SPI_Receive, STACKSIZE, SPI_Receive_Task, NULL,NULL,NULL, TASK_PRIORITY, 0, 0);
```

## inc/main.h
```c
#ifndef MAIN_H_
#define MAIN_H_

#include <stdio.h>
#include <stdlib.h>
#include <string.h>

#include <zephyr.h>
#include <devicetree.h>
#include <device.h>
#include <logging/log.h>
#include <version.h>

#include <drivers/gpio.h>
#include <drivers/spi.h>

#define STACKSIZE 2048
#define TASK_PRIORITY 14

static const struct spi_config spi_cfg_master = {
    .operation = SPI_OP_MODE_MASTER | SPI_WORD_SET(8) | SPI_TRANSFER_MSB,
    .frequency = 500000U,
};

#endif
```
